## components/Networking/Kconfig
```kconfig
menu "Networking"
    choice CONNECT_INTERFACE
        prompt "Connect using"
        default CONNECT_WIFI
        help
            Protocol examples can use Wi-Fi or Ethernet to connect to the network.
            Choose which interface to use.

        config CONNECT_WIFI
            bool "Wi-Fi"

        config CONNECT_ETHERNET
            bool "Ethernet"

    endchoice

    if CONNECT_WIFI
        config WIFI_SSID
            string "WiFi SSID"
            default "myssid"
            help
                SSID (network name) for the example to connect to.

        config WIFI_PASSWORD
            string "WiFi Password"
            default "mypassword"
            help
                WiFi password (WPA or WPA2) for the example to use.
                Can be left blank if the network has no security set.
    endif

    if CONNECT_ETHERNET
        config ETHERNET_DHCP
            bool "Enable DHCP"
            default y
            help
                Whether to start the DHCP client when connected to Ethernet.
    endif

endmenu
```

## examples/esp32/main/Kconfig.projbuild
```kconfig
config BUILD_DOCUMENTATION
    bool "Build doxygen"
    help
        Generate Doxygen documentation for this project in the build process.

menu "Network Configuration"
    choice CONNECT_INTERFACE
        prompt "Connect using"
        default CONNECT_WIFI
        help
            Use Wi-Fi or Ethernet to connect to the network. Choose which interface to use.

        config CONNECT_WIFI
            bool "Wi-Fi"

        config CONNECT_ETHERNET
            bool "Ethernet"

    endchoice

    if CONNECT_WIFI
        config WIFI_SSID
            string "WiFi SSID"
            default "myssid"
            help
                SSID (network name) for the device to connect to.
        config WIFI_PASSWORD
            string "WiFi Password"
            default "mypassword"
            help
                WiFi password (WPA or WPA2) for the device to use.
    endif
endmenu
```

## examples/esp32/sdkconfig.defaults
```kconfig
# force 4MB flash size
CONFIG_ESPTOOLPY_FLASHSIZE_4MB=y
CONFIG_ESPTOOLPY_FLASHSIZE="4MB"

# use custom partition table
CONFIG_PARTITION_TABLE_CUSTOM=y
CONFIG_PARTITION_TABLE_FILENAME="partitions.csv"

# build documentation by default
CONFIG_BUILD_DOCUMENTATION=y

# Build for release by default
CONFIG_BOOTLOADER_COMPILER_OPTIMIZATION_PERF=y
CONFIG_COMPILER_OPTIMIZATION_PERF=y

# 240 MHz cpu frequency
CONFIG_ESP32_DEFAULT_CPU_FREQ_240=y
CONFIG_ESP32_DEFAULT_CPU_FREQ_MHZ=240

# default stack size
CONFIG_ESP_MAIN_TASK_STACK_SIZE=8192
CONFIG_PTHREAD_TASK_STACK_SIZE_DEFAULT=8192
CONFIG_ESP_SYSTEM_EVENT_TASK_STACK_SIZE=8192

# increase DMA buffer size
CONFIG_ETH_DMA_BUFFER_SIZE=1600

# enable HTTPS server implementation
CONFIG_ESP_HTTPS_SERVER_ENABLE=y
CONFIG_ESP_TLS_SERVER=y

# use hardware mpi
CONFIG_MBEDTLS_HARDWARE_MPI=y

# wifi default config
CONFIG_WIFI_SSID="esp32_wifi"
CONFIG_WIFI_PASSWORD="password"

# Enable C++ exceptions
CONFIG_COMPILER_CXX_EXCEPTIONS=y
CONFIG_COMPILER_CXX_EXCEPTIONS_EMG_POOL_SIZE=0

# SPI RAM config
CONFIG_SPIRAM_TYPE_AUTO=y
CONFIG_SPIRAM=y
CONFIG_SPIRAM_BOOT_INIT=y
CONFIG_SPIRAM_IGNORE_NOTFOUND=y
CONFIG_SPIRAM_USE_MALLOC=y
CONFIG_SPIRAM_MEMTEST=y
CONFIG_SPIRAM_TRY_ALLOCATE_WIFI_LWIP=y
CONFIG_SPIRAM_SUPPORT=y
CONFIG_WIFI_LWIP_ALLOCATION_FROM_SPIRAM_FIRST=y
# mbedTLS uses this memory if available
CONFIG_MBEDTLS_DEFAULT_MEM_ALLOC=y
```
